## external/Config.in
```kconfig
menu "Unit OS"
source "$BR2_EXTERNAL_UNIT_PATH/package/unit-release/Config.in"
source "$BR2_EXTERNAL_UNIT_PATH/package/unit-firmware/Config.in"
source "$BR2_EXTERNAL_UNIT_PATH/package/unit-harness/Config.in"
source "$BR2_EXTERNAL_UNIT_PATH/package/unit-compositor/Config.in"
source "$BR2_EXTERNAL_UNIT_PATH/package/unit-services/Config.in"
source "$BR2_EXTERNAL_UNIT_PATH/package/unit-shell/Config.in"
comment "Input methods and fonts for the Shell UI"
source "$BR2_EXTERNAL_UNIT_PATH/package/extra-cmake-modules/Config.in"
source "$BR2_EXTERNAL_UNIT_PATH/package/iso-codes/Config.in"
source "$BR2_EXTERNAL_UNIT_PATH/package/anthy-unicode/Config.in"
source "$BR2_EXTERNAL_UNIT_PATH/package/fcitx5/Config.in"
source "$BR2_EXTERNAL_UNIT_PATH/package/fcitx5-qt/Config.in"
source "$BR2_EXTERNAL_UNIT_PATH/package/fcitx5-anthy/Config.in"
source "$BR2_EXTERNAL_UNIT_PATH/package/font-inter/Config.in"
source "$BR2_EXTERNAL_UNIT_PATH/package/font-noto-sans-cjk-jp/Config.in"
comment "Shell UI libraries"
source "$BR2_EXTERNAL_UNIT_PATH/package/layer-shell-qt/Config.in"
endmenu
```

## external/package/anthy-unicode/Config.in
```kconfig
config BR2_PACKAGE_ANTHY_UNICODE
	bool "anthy-unicode"
	depends on BR2_USE_WCHAR
	help
	  Japanese kana-kanji conversion engine (UTF-8 version of Anthy), used by fcitx5-anthy
	  for Japanese input in emulation. The engine for release is not decided yet.

	  https://github.com/fujiwarat/anthy-unicode
```

## external/package/extra-cmake-modules/Config.in
```kconfig
config BR2_PACKAGE_EXTRA_CMAKE_MODULES
	bool
	help
	  CMake modules from KDE, needed to build Fcitx5 and its add-ons.
	  Staging only. Buildroot's kf5-extra-cmake-modules needs Qt 5.

	  https://invent.kde.org/frameworks/extra-cmake-modules
```

## external/package/fcitx5-anthy/Config.in
```kconfig
config BR2_PACKAGE_FCITX5_ANTHY
	bool "fcitx5-anthy"
	depends on BR2_PACKAGE_FCITX5
	depends on BR2_USE_WCHAR
	select BR2_PACKAGE_ANTHY_UNICODE
	help
	  Anthy Japanese engine for Fcitx5, for emulation. The engine for release is not
	  decided yet.

	  https://github.com/fcitx/fcitx5-anthy
```

## external/package/fcitx5-qt/Config.in
```kconfig
config BR2_PACKAGE_FCITX5_QT
	bool "fcitx5-qt"
	depends on BR2_PACKAGE_FCITX5
	depends on BR2_PACKAGE_QT6BASE_DBUS && BR2_PACKAGE_QT6BASE_GUI
	help
	  Fcitx5 input module for Qt 6, an alternative to Qt's own Wayland text-input path.

	  https://github.com/fcitx/fcitx5-qt
```

## external/package/fcitx5/Config.in
```kconfig
config BR2_PACKAGE_FCITX5
	bool "fcitx5"
	depends on BR2_INSTALL_LIBSTDCPP
	depends on BR2_PACKAGE_SYSTEMD
	depends on BR2_PACKAGE_WAYLAND
	select BR2_PACKAGE_EXTRA_CMAKE_MODULES
	select BR2_PACKAGE_ISO_CODES
	select BR2_PACKAGE_JSON_FOR_MODERN_CPP
	select BR2_PACKAGE_LIBXKBCOMMON
	select BR2_PACKAGE_XKEYBOARD_CONFIG
	select BR2_PACKAGE_EXPAT
	select BR2_PACKAGE_CAIRO
	select BR2_PACKAGE_PANGO
	select BR2_PACKAGE_GDK_PIXBUF
	select BR2_PACKAGE_LIBRSVG
	select BR2_PACKAGE_LIBGLIB2
	select BR2_PACKAGE_WAYLAND_PROTOCOLS
	select BR2_PACKAGE_UTIL_LINUX
	select BR2_PACKAGE_UTIL_LINUX_LIBUUID
	help
	  Input method framework, on Wayland through the input-method protocols (Software
	  Architecture §4, input methods). Toolkit spike (UNIT-OS-WP-0010): no X11.

	  https://github.com/fcitx/fcitx5
```

## external/package/font-inter/Config.in
```kconfig
config BR2_PACKAGE_FONT_INTER
	bool "font-inter"
	help
	  Inter, the interface font of the Visual Design Specification (§9; SIL Open Font
	  License).

	  https://rsms.me/inter/
```

## external/package/font-noto-sans-cjk-jp/Config.in
```kconfig
config BR2_PACKAGE_FONT_NOTO_SANS_CJK_JP
	bool "font-noto-sans-cjk-jp"
	help
	  Noto Sans CJK JP, regular and bold, for Japanese text (Visual Design Specification §9;
	  SIL Open Font License).

	  https://github.com/notofonts/noto-cjk
```

## external/package/iso-codes/Config.in
```kconfig
config BR2_PACKAGE_ISO_CODES
	bool
	help
	  ISO country, language and script names, needed by the Fcitx5 keyboard engine.

	  https://salsa.debian.org/iso-codes-team/iso-codes
```

## external/package/layer-shell-qt/Config.in
```kconfig
config BR2_PACKAGE_LAYER_SHELL_QT
	bool "layer-shell-qt"
	depends on BR2_PACKAGE_QT6WAYLAND
	depends on BR2_PACKAGE_QT6DECLARATIVE
	select BR2_PACKAGE_EXTRA_CMAKE_MODULES
	select BR2_PACKAGE_LIBXKBCOMMON
	select BR2_PACKAGE_WAYLAND_PROTOCOLS
	help
	  Qt 6 support for the wlr-layer-shell Wayland protocol, so the
	  Shell UI can place its status bar, navigation bar, panels,
	  banners and home screen as layer surfaces (UNIT-OS-WP-0009).
	  Includes the org.kde.layershell QML module.

	  https://invent.kde.org/plasma/layer-shell-qt
```

## external/package/unit-compositor/Config.in
```kconfig
config BR2_PACKAGE_UNIT_COMPOSITOR
	bool "unit-compositor"
	depends on BR2_PACKAGE_HOST_RUSTC_TARGET_ARCH_SUPPORTS
	depends on BR2_INIT_SYSTEMD
	select BR2_PACKAGE_HOST_RUSTC
	select BR2_PACKAGE_LIBDRM
	select BR2_PACKAGE_LIBINPUT
	select BR2_PACKAGE_LIBXKBCOMMON
	select BR2_PACKAGE_SEATD
	select BR2_PACKAGE_MESA3D
	select BR2_PACKAGE_MESA3D_OPENGL_EGL
	select BR2_PACKAGE_MESA3D_OPENGL_ES
	help
	  Unit compositor: the Wayland compositor and window manager of
	  Unit OS, built on the Smithay library (Software Architecture
	  r1.16 §4). First version under work package UNIT-OS-WP-0009
	  (Desktop Foundation - Increment 1).
```

## external/package/unit-firmware/Config.in
```kconfig
config BR2_PACKAGE_UNIT_FIRMWARE
	bool "unit-firmware"
	help
	  Intel Panther Lake firmware for Unit OS, from a pinned
	  linux-firmware release: Xe3 graphics (GuC, HuC, GSC),
	  display (DMC) and IPU7 camera, with their licences.
```

## external/package/unit-harness/Config.in
```kconfig
config BR2_PACKAGE_UNIT_HARNESS
	bool "unit-harness"
	help
	  Unit OS test harness and trace capture for development and
	  test images (work package UNIT-OS-WP-0002). Records input
	  timestamps, injects synthetic input, captures bounded kernel
	  traces and writes result records under Performance procedures
	  PA06 (result record), PA07 (pass logic) and PA08 (efficient
	  instrumentation). Not for release images.
```

## external/package/unit-release/Config.in
```kconfig
config BR2_PACKAGE_UNIT_RELEASE
	bool "unit-release"
	help
	  Unit OS identity: /etc/os-release and /etc/unit-release,
	  recording the Unit OS version and the build that produced it.
```

## external/package/unit-services/Config.in
```kconfig
config BR2_PACKAGE_UNIT_SERVICES
	bool "unit-services"
	depends on BR2_PACKAGE_HOST_RUSTC_TARGET_ARCH_SUPPORTS
	depends on BR2_INIT_SYSTEMD
	depends on BR2_PACKAGE_DBUS_BROKER
	select BR2_PACKAGE_HOST_RUSTC
	help
	  Unit Settings, Notification and Session services, first
	  slice for the Shell UI (UNIT-OS-WP-0009; Software
	  Architecture r1.16 section 4). Each runs as a systemd user
	  service on the session bus, started when first called.

comment "unit-services needs systemd and dbus-broker"
	depends on BR2_PACKAGE_HOST_RUSTC_TARGET_ARCH_SUPPORTS
	depends on !BR2_INIT_SYSTEMD || !BR2_PACKAGE_DBUS_BROKER
```

## external/package/unit-shell/Config.in
```kconfig
config BR2_PACKAGE_UNIT_SHELL
	bool "unit-shell"
	depends on BR2_PACKAGE_UNIT_COMPOSITOR
	depends on BR2_PACKAGE_UNIT_SERVICES
	depends on BR2_PACKAGE_QT6BASE_DBUS && BR2_PACKAGE_QT6BASE_GUI
	depends on BR2_PACKAGE_QT6DECLARATIVE_QUICK
	depends on BR2_PACKAGE_QT6WAYLAND
	depends on BR2_PACKAGE_QT6SVG
	select BR2_PACKAGE_LAYER_SHELL_QT
	help
	  Unit Shell UI: the status bar, navigation bar and home screen
	  of Unit OS, in Qt 6 QML (UNIT-OS-DEC-0122), drawn as layer
	  surfaces of the Unit compositor, which starts it. A view over
	  the Unit services (Software Architecture r2.0 §4). Work
	  package UNIT-OS-WP-0009.
```

## external/package/unit-spike-probe/Config.in
```kconfig
config BR2_PACKAGE_UNIT_SPIKE_PROBE
	bool "unit-spike-probe"
	depends on BR2_PACKAGE_HOST_RUSTC_TARGET_ARCH_SUPPORTS
	select BR2_PACKAGE_HOST_RUSTC
	select BR2_PACKAGE_AT_SPI2_CORE
	help
	  Toolkit spike (UNIT-OS-WP-0010): reference screen reader and switch scanner over the
	  AT-SPI bus, and the shared screen specification. Spike branch only.
```

## external/package/unit-spike-qt/Config.in
```kconfig
config BR2_PACKAGE_UNIT_SPIKE_QT
	bool "unit-spike-qt"
	depends on BR2_PACKAGE_QT6
	select BR2_PACKAGE_QT6BASE_GUI
	select BR2_PACKAGE_QT6BASE_DBUS
	select BR2_PACKAGE_QT6DECLARATIVE
	select BR2_PACKAGE_QT6DECLARATIVE_QUICK
	select BR2_PACKAGE_QT6WAYLAND
	select BR2_PACKAGE_QT6SHADERTOOLS
	help
	  Toolkit spike (UNIT-OS-WP-0010): the sign-in and settings screens in Qt 6 QML, after
	  spike/screens.json. Spike branch only.
```

## external/package/unit-spike-slint/Config.in
```kconfig
config BR2_PACKAGE_UNIT_SPIKE_SLINT
	bool "unit-spike-slint"
	depends on BR2_PACKAGE_HOST_RUSTC_TARGET_ARCH_SUPPORTS
	depends on BR2_PACKAGE_HAS_LIBEGL && BR2_PACKAGE_HAS_LIBGLES
	select BR2_PACKAGE_HOST_RUSTC
	select BR2_PACKAGE_LIBXKBCOMMON
	select BR2_PACKAGE_WAYLAND
	select BR2_PACKAGE_FONTCONFIG
	help
	  Toolkit spike (UNIT-OS-WP-0010): the sign-in and settings screens in Slint, after
	  spike/screens.json. Spike branch only.
```
